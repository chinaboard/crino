## sdkconfig.defaults.partition.gen
```kconfig
CONFIG_PARTITION_TABLE_CUSTOM=y
CONFIG_PARTITION_TABLE_CUSTOM_FILENAME="partitions.ota-only.csv"
CONFIG_PARTITION_TABLE_FILENAME="partitions.ota-only.csv"
```
